// ============================================================
// NodoTierra_TodoEnUno.ino -- Boya Ecologica - Semillero ITM
// ============================================================
// Version de UN SOLO ARCHIVO: copia y pega todo esto en un sketch
// nuevo y vacio de Arduino IDE.
//
// COMPILADO Y VERIFICADO SIN ERRORES contra AMBOS cores:
//   Core esp32:esp32 2.0.9 (ESP-IDF 4)
//   Core esp32:esp32 3.0.7 (ESP-IDF 5) <- el mas comun hoy en Arduino IDE
//   arduino-cli 1.5.1
//   Adafruit GFX 1.12.6 + Adafruit BusIO 1.17.4
//   Adafruit ST7735 and ST7789 Library 1.11.0
//
// El codigo detecta automaticamente cual core tienes instalado y
// usa la firma correcta del callback de ESP-NOW en cada caso --
// no hace falta que edites nada por este tema.
//
// LIBRERIAS A INSTALAR (Arduino IDE > Administrar bibliotecas):
//   - Adafruit GFX Library
//   - Adafruit ST7735 and ST7789 Library
//
// PLACA: ESP32 Dev Module (DOIT ESP32 DevKit V1, 30 pines)
// MAC Boya:   38:18:2b:8a:a8:88
// MAC Tierra: f0:24:f9:43:5d:a4
// ============================================================

#include <Arduino.h>
#include <pgmspace.h>
#include <SPI.h>
#include <Adafruit_GFX.h>
#include <Adafruit_ST7735.h>
#include <WiFi.h>
#include <WiFiMulti.h>
#include <esp_now.h>
#include <esp_idf_version.h>
#include <SD.h>
#include <WiFiClientSecure.h>
#include <HTTPClient.h>

// ======================================================================
// MAPA DE PINES  (fuente: pines.h)
// ======================================================================


// ---------- Pantalla TFT 1.8" 128x160 (driver ST7735) ----------
#define TFT_CS    21   // C20 -> F13  (verde)
#define TFT_DC    22   // C23 -> F12  (cafe)
#define TFT_RST    5   // C17 -> F11  (naranja)
#define TFT_SCK   18   // C18 -> F9   (azul, bus compartido)
#define TFT_MOSI  23   // C24 -> F10  (morado, bus compartido)
// BL (backlight) va cableado directo a 3.3V - no usa GPIO

// ---------- microSD (adaptador 6 pines) ----------
#define SD_CS     4    // C14 -> F28  (verde)
#define SD_SCK    18   // C18 -> F27  (azul, bus compartido con TFT)
#define SD_MOSI   23   // C24 -> F26  (morado, bus compartido con TFT)
#define SD_MISO   19   // C19 -> F25  (amarillo, exclusivo de la SD)

// ---------- Botones (fila derecha, VIN...EN) ----------
#define BTN_UP    13   // D13 - navegar arriba / incrementar valor
#define BTN_DOWN  12   // D12 - navegar abajo / decrementar valor
#define BTN_OK    14   // D14 - confirmar / entrar al submenu
#define BTN_BACK  27   // D27 - atras / cancelar

// ---------- Buzzer (alertas / encendido) ----------
#define PIN_BUZZER 26  // GPIO libre, mismo lado fisico que los botones
                       // (pegado a BTN_BACK=27), para no cruzar cableado
                       // hacia el lado de la pantalla/SD.
                       // Si el buzzer consume mas de ~20 mA, no conectarlo
                       // directo al GPIO: usar un transistor NPN (BC547)
                       // como driver, igual que los reles del Nodo Boya.
#define BUZZER_CLIC_BOTONES true  // true = bip corto en cada boton valido

// ---------- Reservados / no usar en este firmware ----------
// GPIO15, GPIO2  -> libres (reserva futura)
// GPIO16 (RX2), GPIO17 (TX2) -> libres (reserva futura)
// GPIO3 (RX0), GPIO1 (TX0)   -> UART0, exclusivos del USB, NO tocar

// ---------- Parametros generales ----------
#define DEBOUNCE_MS       180   // antirrebote por software para los 4 botones
#define PANTALLA_ANCHO    128   // vertical (portrait): ancho menor que el alto
#define PANTALLA_ALTO     160

// ---------- Modo prueba (usar el Nodo Tierra solo, sin la Boya) ----------
// Mantener presionado BTN_OK mientras se enciende/reinicia la placa para
// entrar en este modo. Genera telemetria simulada localmente para poder
// probar pantallas, menus y botones mientras se termina de configurar
// el Nodo Boya. No modifica nada del bloque ESP-NOW: la logica real de
// enlace, envio y recepcion sigue exactamente igual.
static bool g_modoPrueba = false;

// ======================================================================
// ESTRUCTURAS COMPARTIDAS (Nodo Tierra <-> Nodo Boya)  (fuente: comun.h)
// ======================================================================


// Protocolos de muestreo (deben coincidir con el firmware de la Boya)
enum Protocolo : uint8_t {
  PROTOCOLO_P1_AUTOMATICO   = 1,  // por tiempo y profundidad variable
  PROTOCOLO_P2_CONFIGURABLE = 2,  // definido por el investigador
  PROTOCOLO_P3_REACTIVO     = 3,  // disparado por umbrales
};

// Banderas de error / estado (bit a bit)
#define ERR_BATERIA_BAJA     (1 << 0)
#define ERR_SENSOR_PH        (1 << 1)
#define ERR_SENSOR_OD        (1 << 2)
#define ERR_SENSOR_COND      (1 << 3)
#define ERR_SENSOR_TURBIDEZ  (1 << 4)
#define ERR_ASCENSOR_ATASCO  (1 << 5)
#define ERR_ESPNOW_PERDIDA   (1 << 6)

// ---- Bitmask de estado_dispositivos: 1=OK/conectado, 0=falla o no verificado ----
// (debe coincidir exactamente con NodoBoya_TodoEnUno.ino)
#define BIT_ASCENSOR_OK        (1 << 0)
#define BIT_BOMBA_PURGA_OK     (1 << 1)
#define BIT_BOMBA_MUESTREO_OK  (1 << 2)
#define BIT_SENSOR_PH_OK       (1 << 3)
#define BIT_SENSOR_COND_OK     (1 << 4)
#define BIT_SENSOR_TURBIDEZ_OK (1 << 5)
#define BIT_SENSOR_TEMP_OK     (1 << 6)
#define BIT_US1_OK              (1 << 7)   // columna total
#define BIT_US2_OK              (1 << 8)   // calado boya
#define BIT_US3_OK              (1 << 9)   // posicion carro

// Fase actual de la FSM de la Boya (campo estado_fsm) -- debe coincidir
// exactamente con el orden del enum EstadoBoya en NodoBoya_TodoEnUno.ino
#define ESTADO_FSM_MEDIR_COLUMNA     0
#define ESTADO_FSM_BAJAR             1
#define ESTADO_FSM_ESTABILIZAR       2
#define ESTADO_FSM_LEER_SONDA        3
#define ESTADO_FSM_PURGAR            4
#define ESTADO_FSM_LLENAR_RECIPIENTE 5
#define ESTADO_FSM_SUBIR_HOME        6
#define ESTADO_FSM_REGISTRAR_ENVIAR  7
#define ESTADO_FSM_ERROR             8

// ---------- Telemetria que envia la Boya al Nodo Tierra ----------
// IMPORTANTE: debe coincidir byte a byte con DatosBoya_t en
// NodoBoya_TodoEnUno.ino, incluyendo el orden de los campos.
typedef struct __attribute__((packed)) {
  uint32_t timestamp;        // epoch (segundos)
  float    latitud;
  float    longitud;
  float    profundidad_cm;
  float    ph;
  float    conductividad_us; // µS/cm
  float    oxigeno_disuelto; // mg/L (sensor no instalado todavia, siempre 0)
  float    turbidez_ntu;
  float    temperatura_c;
  uint8_t  bateria_pct;      // 0-100 (banco de pruebas: fijo en 100)
  uint8_t  protocolo_activo; // ver enum Protocolo
  uint8_t  muestras_ciclo;   // cuantas pasadas se hicieron al recipiente
  uint16_t error_flags;      // ver ERR_*
  uint16_t paquetes_perdidos;// contador para verificar RNF-03 (<5% a 50 m)
  // ---- Campos v2 (agregados al final, ver NodoBoya_TodoEnUno.ino) ----
  float    columna_total_cm; // US1: profundidad total del cuerpo de agua
  float    calado_boya_cm;   // US2: calado de la boya
  float    pos_carro_cm;     // US3: posicion del carro del ascensor
  uint16_t estado_dispositivos; // bitmask BIT_*
  // ---- Campos v3 (trazado del lecho / plano cartesiano) ----
  float    gps_avance_m;     // avance horizontal (metros) -- simulado hasta
                              // que se instale el modulo GPS real
  uint8_t  estado_fsm;       // fase actual del ciclo en la Boya (ver FSM_* )
} DatosBoya_t;

// ---------- Comando que el Nodo Tierra envia a la Boya ----------
typedef struct __attribute__((packed)) {
  uint8_t  comando;           // 1=cambiar protocolo, 2=iniciar ciclo manual
  uint8_t  protocolo_nuevo;   // Protocolo deseado (si comando==1)
  uint8_t  num_puntos_prof;   // P2: cuantos puntos de profundidad (1-5)
  uint16_t profundidades_cm[5]; // P2: hasta 5 profundidades en cm
  uint8_t  muestras_por_ciclo;// P2: 1-5 frascos por ciclo
} ComandoTierra_t;

// Direccion MAC del Nodo Boya (confirmada por el usuario)
static uint8_t MAC_NODO_BOYA[6] = {0x38, 0x18, 0x2B, 0x8A, 0xA8, 0x88};

// Referencia: MAC de este mismo Nodo Tierra (usala en el firmware de la
// Boya para que ella tambien pueda enviarte comandos/confirmaciones a ti):
// f0:24:f9:43:5d:a4

// ======================================================================
// PICTOGRAMAS 16x16  (fuente: iconos.h)
// ======================================================================


// ---------- Reloj (Protocolo 1 · automatico por tiempo/profundidad) ----------
static const uint8_t PROGMEM icono_reloj[16] = {
  0b00111100,
  0b01000010,
  0b10000001,
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  0b00000000,
};

// ---------- Deslizadores (Protocolo 2 · configurable) ----------
static const uint8_t PROGMEM icono_config[16] = {
  0b00000000,
  0b00111100,
  0b00100100,
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  0b00000000,
};

// ---------- Campana (Protocolo 3 · reactivo por eventos) ----------
static const uint8_t PROGMEM icono_alerta[16] = {
  0b00011000,
  0b00100100,
  0b00100100,
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  0b00000000,
};

// ---------- Antena / ESP-NOW (transmision con la Boya) ----------
static const uint8_t PROGMEM icono_enlace[16] = {
  0b00000000,
  0b00011000,
  0b00100100,
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  0b00000000,
};

// ---------- Tarjeta SD (almacenamiento local) ----------
static const uint8_t PROGMEM icono_sd[16] = {
  0b01111110,
  0b10000101,
  0b10000101,
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  0b00000000,
};

// ---------- Nube (subida de datos) ----------
static const uint8_t PROGMEM icono_nube[16] = {
  0b00000000,
  0b00011100,
  0b00100010,
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  0b00000000,
};

// ---------- Bateria (nivel de la Boya, telemetria) ----------
static const uint8_t PROGMEM icono_bateria[16] = {
  0b01111100,
  0b11111110,
  0b10000011,
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  0b00000000,
};

// ======================================================================
// ESCUDOS - bitmaps RGB565 84x84 (agrandados, version 2)
// entregadas por el usuario: Universidad Libre e Ingenieria Industrial)
// ======================================================================
#define LOGO_LADO 84

static const uint16_t PROGMEM logo_universidad_libre[84 * 84] = {
  0xFFFF,0xFFFF,0xFFFF,0xFFFF,0xFFFF,0xFFFF,0xFFFF,0xFFFF,0xFFFF,0xFFFF,0xFFFF,0xFFFF,0xFFFF,0xFFFF,
  0xFFFF,0xFFFF,0xFFFF,0xFFFF,0xFFFF,0xFFFF,0xFFFF,0xFFFF,0xFFFF,0xFFFF,0xFFFF,0xFFFF,0xFFFF,0xFFFE,
  0xFFFE,0xFFFF,0xFFFF,0xFFFF,0xFFDD,0xF758,0xE6B3,0xD64E,0xCDE9,0xC5A7,0xC566,0xC545,0xBD24,0xBD24,
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  0xFFFF,0xFFFF,0xFFFF,0xFFFF,0xFFFF,0xFFFF,0xFFFF,0xFFFF,0xFFFF,0xFFFF,0xFFFF,0xFFFF,0xFFFF,0xFFFF,
};

static const uint16_t PROGMEM logo_ingenieria_industrial[84 * 84] = {
  0xEF7E,0xE75E,0xE75E,0xF7BE,0xFFDF,0xFFFF,0xFFFF,0xFFFF,0xFFFF,0xFFFF,0xFFFF,0xFFFF,0xFFFF,0xFFFF,
  0xFFFF,0xFFFF,0xFFFF,0xFFFF,0xFFFF,0xFFFF,0xFFFF,0xFFFF,0xFFFF,0xFFFF,0xFFFF,0xFFFF,0xFFFF,0xFFFF,
  0xFFFF,0xFFFF,0xFFFF,0xFFFF,0xFFFF,0xFFFF,0xFFFF,0xFFFF,0xFFFF,0xFFFF,0xFFFF,0xFFFF,0xFFFF,0xFFFF,
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  0xFFFF,0xFFFF,0xFFFF,0xFFFF,0xFFFF,0xFFFF,0xFFFF,0xFFFF,0xFFFF,0xFFFF,0xFFFF,0xFFFF,0xFFFF,0xF7BE,
};

// ======================================================================
// BOTONES - tipo Boton  (fuente: botones.h)
// ======================================================================
enum Boton : uint8_t { BOTON_NINGUNO = 0, BOTON_ARRIBA, BOTON_ABAJO, BOTON_OK, BOTON_ATRAS };

// ======================================================================
// PROTOTIPOS DE FUNCIONES
// ======================================================================
void pantalla_iniciar();
void pantalla_splash();
void pantalla_menu_protocolo(uint8_t seleccion);
void pantalla_config_p2(uint8_t campo, uint8_t num_puntos, uint16_t* profundidades, uint8_t muestras);
void pantalla_estado(const DatosBoya_t& datos, bool enlaceOk, bool sdOk);
void pantalla_vinculando();
void pantalla_estados_dispositivos(const DatosBoya_t& datos);
void pantalla_barras(const DatosBoya_t& datos);
void pantalla_plano_cartesiano(const DatosBoya_t& datos);
void pantalla_mensaje(const char* linea1, const char* linea2);
void botones_iniciar();
Boton botones_leer();

// ---------- Buzzer ----------
void buzzer_iniciar();
void buzzer_tono(uint16_t frecuencia_hz, uint16_t duracion_ms);
void buzzer_melodia_encendido();
void buzzer_melodia_apagado();
void buzzer_melodia_alerta();
void buzzer_clic();
void buzzer_melodia_vinculado();
void buzzer_melodia_moneda();
void buzzer_melodia_sin_conexion();
void buzzer_melodia_falla();
void espnow_iniciar();
bool espnow_enviar_comando(const ComandoTierra_t& cmd);
bool espnow_hay_datos_nuevos();
DatosBoya_t espnow_obtener_ultimo_dato();
bool espnow_enlace_activo();
bool almacenamiento_iniciar();
bool almacenamiento_ok();
void almacenamiento_guardar(const DatosBoya_t& d);
void nube_iniciar();
bool nube_conectada();
bool nube_subir(const DatosBoya_t& d);
void setup();
void loop();
static void procesarDatoRecibido(const uint8_t* data, int len);
#if ESP_IDF_VERSION_MAJOR >= 5
void onDatoRecibido(const esp_now_recv_info_t* info, const uint8_t* data, int len);
#else
void onDatoRecibido(const uint8_t* mac, const uint8_t* data, int len);
#endif

// ======================================================================
// PANTALLA TFT  (fuente: pantalla.cpp)
// ======================================================================


Adafruit_ST7735 tft = Adafruit_ST7735(TFT_CS, TFT_DC, TFT_RST);

#define COLOR_FONDO   ST77XX_BLACK
#define COLOR_TEXTO   ST77XX_WHITE
#define COLOR_ACENTO  ST77XX_CYAN
#define COLOR_ALERTA  ST77XX_RED
#define COLOR_OK      ST77XX_GREEN

static const char* NOMBRE_PROTOCOLO[3] = {
  "P1 Automatico",
  "P2 Configurable",
  "P3 Reactivo",
};

void pantalla_iniciar() {
  // El bus SPI (SCK=18, MOSI=23) ya debe estar inicializado por SD.begin()
  // en almacenamiento.cpp ANTES de llamar a esta funcion, o se inicializa
  // aqui mismo si la SD se inicia despues. Ver orden en NodoTierra.ino.
  tft.initR(INITR_BLACKTAB);      // ajustar a INITR_GREENTAB si los colores salen invertidos
  tft.setRotation(0);             // vertical, 128x160 (orientacion natural del panel)
  tft.fillScreen(COLOR_FONDO);
  tft.setTextWrap(false);
}

// Dibuja un escudo (56x56, RGB565) comprimido horizontalmente a
// 'anchoDestino' pixeles, centrado. anchoDestino va de 0 a LOGO_LADO
// y decreciendo/creciendo en el tiempo simula el giro de una moneda
// sobre su eje vertical.
void dibujarEscudoEscalado(const uint16_t* bitmap, int anchoDestino) {
  if (anchoDestino <= 0) return;
  int x0 = (PANTALLA_ANCHO - anchoDestino) / 2;
  int y0 = 52;
  for (int yy = 0; yy < LOGO_LADO; yy++) {
    for (int xxDest = 0; xxDest < anchoDestino; xxDest++) {
      int xxSrc = (xxDest * LOGO_LADO) / anchoDestino;
      uint16_t color = pgm_read_word(&bitmap[yy * LOGO_LADO + xxSrc]);
      tft.drawPixel(x0 + xxDest, y0 + yy, color);
    }
  }
}

// Pantalla de inicio: titulo, "Nodo Tierra", escudos estaticos en secuencia
// (Universidad Libre 5 s, luego Ingenieria Industrial) y credito. Cualquier
// boton salta la secuencia de inmediato, para no bloquear el uso del
// resto del dispositivo mientras se gestiona el modulo Boya.
void pantalla_splash() {
  tft.fillScreen(COLOR_FONDO);

  tft.setTextSize(1);
  tft.setTextColor(COLOR_ACENTO);
  tft.setCursor(4, 2);
  tft.print("Muestreador de");
  tft.setCursor(4, 10);
  tft.print("Calidad de Aguas");

  tft.setTextSize(2);
  tft.setTextColor(COLOR_TEXTO);
  tft.setCursor(4, 20);
  tft.print("Nodo");
  tft.setCursor(4, 36);
  tft.print("Tierra");

  // Insignia de Modo Prueba como badge en la esquina, para no quitarle
  // espacio vertical al logo (que ahora es mucho mas grande).
  if (g_modoPrueba) {
    tft.fillRect(84, 0, 44, 10, COLOR_ALERTA);
    tft.setTextColor(COLOR_TEXTO);
    tft.setCursor(86, 1);
    tft.print("PRUEBA");
  }

  tft.setTextSize(1);
  tft.setTextColor(COLOR_TEXTO);
  tft.setCursor(4, 140);
  tft.print("Hecho por");
  tft.setCursor(4, 150);
  tft.print("Ing. Jair E.");

  // --- Escudos estaticos (sin giro): primero Universidad Libre 5 s,
  //     despues Ingenieria Industrial. Cualquier boton salta todo. ---
  tft.fillRect(0, 52, PANTALLA_ANCHO, LOGO_LADO, COLOR_FONDO);
  dibujarEscudoEscalado(logo_universidad_libre, LOGO_LADO);
  unsigned long t0 = millis();
  while (millis() - t0 < 5000) {
    if (botones_leer() != BOTON_NINGUNO) return;   // salta toda la intro
  }

  tft.fillRect(0, 52, PANTALLA_ANCHO, LOGO_LADO, COLOR_FONDO);
  dibujarEscudoEscalado(logo_ingenieria_industrial, LOGO_LADO);
  unsigned long t1 = millis();
  while (millis() - t1 < 3000) {
    if (botones_leer() != BOTON_NINGUNO) return;
  }
}

// Pantalla de seleccion de protocolo (menu principal, navegado con UP/DOWN/OK)
void pantalla_menu_protocolo(uint8_t seleccion) {
  tft.fillScreen(COLOR_FONDO);
  tft.setTextSize(1);
  tft.setTextColor(COLOR_ACENTO);
  tft.setCursor(4, 2);
  tft.print("Elegir protocolo");
  if (g_modoPrueba) {
    tft.setTextColor(COLOR_ALERTA);
    tft.setCursor(4, 12);
    tft.print("[MODO PRUEBA]");
    tft.setTextColor(COLOR_ACENTO);
  }
  tft.drawFastHLine(0, 22, PANTALLA_ANCHO, COLOR_ACENTO);

  const uint8_t* iconos[3] = {icono_reloj, icono_config, icono_alerta};

  for (uint8_t i = 0; i < 3; i++) {
    int y = 30 + i * 30;
    bool activo = (i == seleccion);
    if (activo) {
      tft.fillRect(0, y - 3, PANTALLA_ANCHO, 26, ST77XX_BLUE);
    }
    tft.drawBitmap(6, y, iconos[i], 8, 16, activo ? COLOR_TEXTO : COLOR_ACENTO);
    tft.setCursor(28, y + 4);
    tft.setTextColor(activo ? COLOR_TEXTO : COLOR_ACENTO);
    tft.print(NOMBRE_PROTOCOLO[i]);
  }

  tft.setTextColor(COLOR_TEXTO);
  tft.setCursor(4, 140);
  tft.print("OK = elegir");
  tft.setCursor(4, 150);
  tft.print("UP/DN = mover");
}

// Pantalla de configuracion del Protocolo 2 (edicion con los 4 botones)
// campo: 0=num_puntos, 1..5=profundidad de cada punto, 6=muestras_por_ciclo
void pantalla_config_p2(uint8_t campo, uint8_t num_puntos, uint16_t* profundidades, uint8_t muestras) {
  tft.fillScreen(COLOR_FONDO);
  tft.setTextSize(1);
  tft.setTextColor(COLOR_ACENTO);
  tft.setCursor(4, 2);
  tft.print("Config. Protocolo 2");
  tft.drawFastHLine(0, 12, PANTALLA_ANCHO, COLOR_ACENTO);
  tft.drawBitmap(108, 14, icono_config, 8, 16, COLOR_ACENTO);

  tft.setTextColor(campo == 0 ? COLOR_OK : COLOR_TEXTO);
  tft.setCursor(4, 18);
  tft.print("Puntos prof.: ");
  tft.print(num_puntos);

  for (uint8_t i = 0; i < num_puntos && i < 5; i++) {
    tft.setTextColor((campo == i + 1) ? COLOR_OK : COLOR_TEXTO);
    tft.setCursor(10, 34 + i * 12);
    tft.print("Punto ");
    tft.print(i + 1);
    tft.print(": ");
    tft.print(profundidades[i]);
    tft.print(" cm");
  }

  tft.setTextColor(campo == 6 ? COLOR_OK : COLOR_TEXTO);
  tft.setCursor(4, 100);
  tft.print("Muestras/ciclo: ");
  tft.print(muestras);

  tft.setTextColor(COLOR_TEXTO);
  tft.setCursor(4, 136);
  tft.print("UP/DN = valor");
  tft.setCursor(4, 146);
  tft.print("OK = siguiente");
  tft.setCursor(4, 156);
  tft.print("BACK = enviar");
}

// Genera ".", "..", "...", "..", "." (creciente y decreciente en el
// tiempo) -- se usa en vez de un valor cuando ese dato todavia no ha
// llegado de la Boya, para no mostrar un cero o un numero viejo como si
// fuera valido.
String puntosSuspensivosAnimados(uint8_t maxPuntos = 3, uint16_t periodoMs = 350) {
  uint32_t ciclo = (millis() / periodoMs) % (uint32_t)(2 * maxPuntos);
  uint8_t n = (ciclo <= maxPuntos) ? (uint8_t)ciclo : (uint8_t)(2 * maxPuntos - ciclo);
  if (n == 0) n = 1;
  String s;
  for (uint8_t i = 0; i < n; i++) s += '.';
  return s;
}

// Pantalla de estado / telemetria recibida de la Boya
// Se muestra apenas termina el splash. Espera el primer paquete real del
// Nodo 2 (o el primero simulado, si esta activo el Modo Prueba) antes de
// dejar avanzar. BACK permite saltarla manualmente (util para pruebas de
// banco sin la Boya encendida).
void pantalla_vinculando() {
  tft.fillScreen(COLOR_FONDO);
  tft.setTextSize(1);
  tft.setTextColor(COLOR_ACENTO);
  tft.setCursor(4, 4);
  tft.print("Nodo 1 (Tierra)");
  tft.setTextSize(2);
  tft.setTextColor(COLOR_TEXTO);
  tft.setCursor(4, 60);
  tft.print("Vincul.");
  tft.setCursor(4, 78);
  tft.print("con 2");
  tft.print(puntosSuspensivosAnimados());
  tft.setTextSize(1);
  tft.setTextColor(COLOR_ACENTO);
  tft.setCursor(4, 130);
  tft.print("Esperando la Boya");
  tft.setCursor(4, 140);
  tft.print("(Nodo 2)");
  tft.setCursor(4, 152);
  tft.print("BACK = omitir");
}

// Lista de sensores/actuadores de la Boya con su estado (bit a bit desde
// estado_dispositivos). OK avanza a la pantalla de barras.
void pantalla_estados_dispositivos(const DatosBoya_t& datos) {
  Serial.println("[PANTALLA] entrando a pantalla_estados_dispositivos()");
  tft.fillScreen(COLOR_FONDO);
  tft.setTextSize(1);
  tft.setTextColor(COLOR_ACENTO);
  tft.setCursor(4, 2);
  tft.print("Nodo 2: estado");
  tft.drawFastHLine(0, 12, PANTALLA_ANCHO, COLOR_ACENTO);

  struct { const char* nombre; uint16_t bit; } items[] = {
    {"Ascensor",   BIT_ASCENSOR_OK},
    {"Bomba purga",BIT_BOMBA_PURGA_OK},
    {"Bomba muestreo", BIT_BOMBA_MUESTREO_OK},
    {"Sensor pH",  BIT_SENSOR_PH_OK},
    {"Sensor Cond",BIT_SENSOR_COND_OK},
    {"Sensor Turb",BIT_SENSOR_TURBIDEZ_OK},
    {"Sensor Temp",BIT_SENSOR_TEMP_OK},
    {"US1 columna",BIT_US1_OK},
    {"US2 calado", BIT_US2_OK},
    {"US3 carro",  BIT_US3_OK},
  };
  for (int i = 0; i < 10; i++) {
    bool ok = datos.estado_dispositivos & items[i].bit;
    tft.setTextColor(ok ? COLOR_OK : COLOR_ALERTA);
    tft.setCursor(4, 16 + i * 12);
    tft.print(items[i].nombre);
    tft.setCursor(100, 16 + i * 12);
    tft.print(ok ? "OK" : "--");
  }

  tft.setTextColor(COLOR_TEXTO);
  tft.setCursor(4, 150);
  tft.print("OK = continuar");
  Serial.println("[PANTALLA] saliendo de pantalla_estados_dispositivos() -- deberia verse ya en la TFT");
}

// Barras verticales delgadas de colores distintos, en vivo, para los 3
// sensores ultrasonicos y los 4 parametros de la sonda.
void pantalla_barras(const DatosBoya_t& datos) {
  tft.fillScreen(COLOR_FONDO);
  tft.setTextSize(1);
  tft.setTextColor(COLOR_ACENTO);
  tft.setCursor(4, 2);
  tft.print("Nodo 2: lecturas");
  tft.drawFastHLine(0, 12, PANTALLA_ANCHO, COLOR_ACENTO);

  // Cada barra: {valor, max_esperado, color, etiqueta}
  struct { float valor; float maxEsperado; uint16_t color; const char* etiqueta; } barras[] = {
    {datos.columna_total_cm, 200.0f, ST77XX_CYAN,   "COL"},
    {datos.calado_boya_cm,    50.0f, ST77XX_BLUE,   "CAL"},
    {datos.pos_carro_cm,     120.0f, ST77XX_WHITE,  "CAR"},
    {datos.ph,                14.0f, ST77XX_GREEN,  "PH"},
    {datos.conductividad_us,1000.0f, ST77XX_YELLOW, "COND"},
    {datos.turbidez_ntu,     100.0f, 0xFD20,         "TURB"},  // naranja (RGB565 directo)
    {datos.temperatura_c,     40.0f, ST77XX_RED,    "TEMP"},
  };
  const int nBarras = 7;
  const int anchoBarra = 12;
  const int espacio = 6;
  const int yBase = 130;      // linea base de las barras
  const int alturaMax = 100;  // alto maximo de una barra llena

  int x = 4;
  for (int i = 0; i < nBarras; i++) {
    float frac = barras[i].valor / barras[i].maxEsperado;
    frac = constrain(frac, 0.0f, 1.0f);
    int alto = (int)(frac * alturaMax);

    tft.drawRect(x, yBase - alturaMax, anchoBarra, alturaMax, COLOR_ACENTO);
    tft.fillRect(x, yBase - alto, anchoBarra, alto, barras[i].color);

    tft.setTextColor(COLOR_TEXTO);
    tft.setCursor(x - 1, yBase + 2);
    tft.print(barras[i].etiqueta);

    x += anchoBarra + espacio;
  }

  tft.setTextColor(COLOR_ACENTO);
  tft.setCursor(4, 150);
  tft.print("OK = elegir protocolo");
}

// ======================================================================
// PLANO CARTESIANO -- trazado del lecho del rio
// Eje X = avance horizontal (GPS, simulado hasta instalar el modulo real)
// Eje Y = profundidad. Y=0 es la linea de flotabilidad (superficie);
// hacia abajo en pantalla = profundidad positiva creciente (visualmente
// equivale a "Y negativo" en el sentido matematico que se pidio).
// ======================================================================
// TRAZA_MAX_PUNTOS controla cuanto tiempo/distancia cubre el trazado
// antes de empezar a descartar los puntos mas viejos (buffer circular).
// Ejemplo: con el filtro de 0.15 m entre puntos (mas abajo), 100 puntos
// cubren ~15 m de recorrido. Si la Boya avanza ~0.25 m/s, eso equivale
// a ~60 s de historial visible. Sube este numero si necesitas cubrir mas
// tiempo/distancia (cada punto ocupa 8 bytes, hay memoria de sobra).
#define TRAZA_MAX_PUNTOS 100
struct PuntoTraza { float x_m; float prof_cm; };
static PuntoTraza g_traza[TRAZA_MAX_PUNTOS];
static uint8_t g_trazaCount = 0;
static uint8_t g_trazaInicio = 0;
static float g_ultimoXRegistrado = -999.0f;

// Suavizado tipo Chaikin (una pasada, "corte de esquinas"): convierte una
// polilinea de segmentos rectos en una curva mas redondeada, sin necesitar
// splines completos -- barato en CPU y memoria para un microcontrolador.
struct PtoPix { int16_t x; int16_t y; };

int suavizarChaikin(PtoPix* origen, int n, PtoPix* destino) {
  if (n < 3) {
    for (int i = 0; i < n; i++) destino[i] = origen[i];
    return n;
  }
  int m = 0;
  destino[m++] = origen[0];
  for (int i = 0; i < n - 1; i++) {
    PtoPix a = origen[i], b = origen[i + 1];
    destino[m++] = { (int16_t)(a.x + (b.x - a.x) * 0.25f), (int16_t)(a.y + (b.y - a.y) * 0.25f) };
    destino[m++] = { (int16_t)(a.x + (b.x - a.x) * 0.75f), (int16_t)(a.y + (b.y - a.y) * 0.75f) };
  }
  destino[m++] = origen[n - 1];
  return m;
}

void trazaAgregarPunto(float x_m, float prof_cm) {
  // Filtra puntos demasiado seguidos, para no saturar el buffer mientras
  // la Boya practicamente no se mueve.
  if (g_trazaCount > 0 && fabs(x_m - g_ultimoXRegistrado) < 0.15f) return;
  g_ultimoXRegistrado = x_m;
  uint8_t idx = (g_trazaInicio + g_trazaCount) % TRAZA_MAX_PUNTOS;
  if (g_trazaCount < TRAZA_MAX_PUNTOS) {
    g_traza[idx].x_m = x_m;
    g_traza[idx].prof_cm = prof_cm;
    g_trazaCount++;
  } else {
    g_traza[g_trazaInicio].x_m = x_m;
    g_traza[g_trazaInicio].prof_cm = prof_cm;
    g_trazaInicio = (g_trazaInicio + 1) % TRAZA_MAX_PUNTOS;
  }
}

const char* nombreFaseFsm(uint8_t fase) {
  switch (fase) {
    case ESTADO_FSM_MEDIR_COLUMNA:     return "Midiendo columna";
    case ESTADO_FSM_BAJAR:             return "Ascensor bajando";
    case ESTADO_FSM_ESTABILIZAR:       return "Estabilizando";
    case ESTADO_FSM_LEER_SONDA:        return "Sonda midiendo";
    case ESTADO_FSM_PURGAR:            return "Purgando";
    case ESTADO_FSM_LLENAR_RECIPIENTE: return "Tomando muestra";
    case ESTADO_FSM_SUBIR_HOME:        return "Ascensor subiendo";
    case ESTADO_FSM_REGISTRAR_ENVIAR:  return "Registrando datos";
    default:                           return "Error";
  }
}

void pantalla_plano_cartesiano(const DatosBoya_t& datos) {
  tft.fillScreen(COLOR_FONDO);
  tft.setTextSize(1);
  tft.setTextColor(COLOR_ACENTO);
  tft.setCursor(2, 2);
  tft.print("Lecho del rio (Nodo 2)");
  tft.setTextColor(ST77XX_YELLOW);
  tft.setCursor(2, 12);
  tft.print("Avance GPS: ");
  tft.print(datos.gps_avance_m, 1);
  tft.print(" m");

  // Registrar el punto actual del lecho (US1) en la traza
  if (datos.estado_dispositivos & BIT_US1_OK) {
    trazaAgregarPunto(datos.gps_avance_m, datos.columna_total_cm);
  }

  const int plotX0 = 24, plotX1 = PANTALLA_ANCHO - 4;
  const int y0 = 26;      // linea de flotabilidad (Y=0)
  const int yMax = 104;   // limite inferior del area de dibujo (deja espacio a las etiquetas X debajo)
  const float PX_POR_CM = 0.5f;

  // Eje Y=0 -- linea de flotabilidad
  tft.drawFastHLine(plotX0, y0, plotX1 - plotX0, COLOR_TEXTO);
  tft.setTextColor(COLOR_TEXTO);
  tft.setCursor(plotX0, y0 - 9);
  tft.print("Y=0 (flotabilidad)");

  // Escala numerica del eje Y (profundidad en cm), cada 40 cm
  tft.setTextColor(COLOR_ACENTO);
  for (int cm = 40; y0 + (int)(cm * PX_POR_CM) <= yMax; cm += 40) {
    int ytick = y0 + (int)(cm * PX_POR_CM);
    tft.drawFastHLine(plotX0 - 3, ytick, 3, COLOR_ACENTO);
    tft.setCursor(0, ytick - 3);
    tft.print(cm);
  }

  // Escala horizontal segun el rango de X ya registrado
  float xMin = 1e9f, xMax = -1e9f;
  for (uint8_t i = 0; i < g_trazaCount; i++) {
    float x = g_traza[(g_trazaInicio + i) % TRAZA_MAX_PUNTOS].x_m;
    if (x < xMin) xMin = x;
    if (x > xMax) xMax = x;
  }
  if (g_trazaCount < 2) { xMin = 0; xMax = 1; }
  float rangoX = (xMax - xMin < 0.5f) ? 0.5f : (xMax - xMin);

  // Escala numerica del eje X (metros de avance), 4 marcas
  tft.setTextColor(COLOR_ACENTO);
  for (int i = 0; i <= 4; i++) {
    float valorM = xMin + rangoX * i / 4.0f;
    int xtick = plotX0 + (int)((float)i / 4.0f * (plotX1 - plotX0));
    tft.drawFastVLine(xtick, yMax, 3, COLOR_ACENTO);
    tft.setCursor(constrain(xtick - 8, 0, PANTALLA_ANCHO - 20), yMax + 5);
    tft.print(valorM, 1);
  }

  // Trazado del lecho: primero se calculan los puntos en pixeles, luego
  // se suavizan (Chaikin, 1 pasada) para una curva mas "profesional" en
  // vez de segmentos rectos entre cada medicion.
  static PtoPix crudo[TRAZA_MAX_PUNTOS];
  static PtoPix suave[TRAZA_MAX_PUNTOS * 2 + 2];
  int nCrudo = 0;
  for (uint8_t i = 0; i < g_trazaCount; i++) {
    PuntoTraza p = g_traza[(g_trazaInicio + i) % TRAZA_MAX_PUNTOS];
    int px = plotX0 + (int)(((p.x_m - xMin) / rangoX) * (plotX1 - plotX0));
    int py = constrain((int)(y0 + p.prof_cm * PX_POR_CM), y0, yMax);
    crudo[nCrudo].x = px; crudo[nCrudo].y = py;
    nCrudo++;
  }
  int nSuave = suavizarChaikin(crudo, nCrudo, suave);
  for (int i = 0; i < nSuave - 1; i++) {
    tft.drawLine(suave[i].x, suave[i].y, suave[i+1].x, suave[i+1].y, ST77XX_CYAN);
  }
  // Puntos reales de medicion, encima de la curva suavizada
  for (int i = 0; i < nCrudo; i++) {
    tft.fillCircle(crudo[i].x, crudo[i].y, 2, ST77XX_CYAN);
  }

  // Marcadores actuales (calado y carro/sonda), pegados al borde derecho
  int pxActual = plotX1 - 2;
  if (datos.estado_dispositivos & BIT_US2_OK) {
    int pyCal = constrain((int)(y0 + datos.calado_boya_cm * PX_POR_CM), y0, yMax);
    tft.fillCircle(pxActual, pyCal, 3, ST77XX_BLUE);
  }
  if (datos.estado_dispositivos & BIT_US3_OK) {
    int pyCarro = constrain((int)(y0 + datos.pos_carro_cm * PX_POR_CM), y0, yMax);
    tft.fillCircle(pxActual, pyCarro, 3, ST77XX_WHITE);

    // Flecha de direccion del ascensor, segun la fase activa
    if (datos.estado_fsm == ESTADO_FSM_BAJAR) {
      tft.setTextColor(ST77XX_YELLOW);
      tft.setCursor(pxActual - 30, pyCarro - 4);
      tft.print("v BAJA");
    } else if (datos.estado_fsm == ESTADO_FSM_SUBIR_HOME) {
      tft.setTextColor(ST77XX_YELLOW);
      tft.setCursor(pxActual - 30, pyCarro - 4);
      tft.print("^ SUBE");
    }
  }

  // Leyenda de colores (compacta)
  tft.setTextSize(1);
  tft.fillCircle(6, 122, 2, ST77XX_CYAN);   tft.setTextColor(ST77XX_CYAN);   tft.setCursor(11, 119); tft.print("Lecho");
  tft.fillCircle(46, 122, 2, ST77XX_BLUE);  tft.setTextColor(ST77XX_BLUE);   tft.setCursor(51, 119); tft.print("Calado");
  tft.fillCircle(94, 122, 2, ST77XX_WHITE); tft.setTextColor(ST77XX_WHITE);  tft.setCursor(99, 119); tft.print("Carro");

  // Simbolo de fase activa (sonda midiendo / purgando / tomando muestra)
  uint16_t colorBadge = COLOR_ACENTO;
  bool mostrarBadge = true;
  const char* textoBadge = "";
  switch (datos.estado_fsm) {
    case ESTADO_FSM_LEER_SONDA:        textoBadge = "* SONDA MIDIENDO *";  colorBadge = ST77XX_GREEN;  break;
    case ESTADO_FSM_PURGAR:            textoBadge = "* PURGANDO *";       colorBadge = 0xFD20;         break;
    case ESTADO_FSM_LLENAR_RECIPIENTE: textoBadge = "* TOMANDO MUESTRA *";colorBadge = ST77XX_MAGENTA; break;
    default: mostrarBadge = false; break;
  }
  if (mostrarBadge) {
    int anchoTexto = strlen(textoBadge) * 6;
    tft.fillRect(2, 145, anchoTexto + 6, 10, colorBadge);
    tft.setTextColor(ST77XX_BLACK);
    tft.setCursor(5, 147);
    tft.print(textoBadge);
  } else {
    tft.setTextColor(COLOR_ACENTO);
    tft.setCursor(2, 147);
    tft.print(nombreFaseFsm(datos.estado_fsm));
  }

  tft.setTextColor(COLOR_ACENTO);
  tft.setCursor(2, 157);
  tft.print("BACK=menu OK=lecturas");
}

void pantalla_estado(const DatosBoya_t& datos, bool enlaceOk, bool sdOk) {
  tft.fillScreen(COLOR_FONDO);
  tft.setTextSize(1);

  // --- barra superior de iconos de estado ---
  tft.drawBitmap(2, 2, icono_enlace, 8, 16, enlaceOk ? COLOR_OK : COLOR_ALERTA);
  tft.drawBitmap(16, 2, icono_sd, 8, 16, sdOk ? COLOR_OK : COLOR_ALERTA);
  tft.drawBitmap(30, 2, icono_bateria, 8, 16, datos.bateria_pct > 20 ? COLOR_OK : COLOR_ALERTA);
  tft.setCursor(40, 6);
  tft.setTextColor(COLOR_TEXTO);
  tft.print(datos.bateria_pct);
  tft.print("%");

  const uint8_t* icono_proto = icono_reloj;
  if (datos.protocolo_activo == PROTOCOLO_P2_CONFIGURABLE) icono_proto = icono_config;
  if (datos.protocolo_activo == PROTOCOLO_P3_REACTIVO)     icono_proto = icono_alerta;
  tft.drawBitmap(72, 2, icono_proto, 8, 16, COLOR_ACENTO);
  tft.setCursor(84, 6);
  tft.print("P");
  tft.print(datos.protocolo_activo);

  if (g_modoPrueba) {
    tft.fillRect(104, 0, 24, 10, COLOR_ALERTA);
    tft.setCursor(105, 1);
    tft.setTextColor(COLOR_TEXTO);
    tft.print("SIM");
  }

  tft.drawFastHLine(0, 20, PANTALLA_ANCHO, COLOR_ACENTO);

  // --- lecturas ---
  // Si el bit BIT_SENSOR_*_OK correspondiente no esta activo, se muestra
  // una animacion de puntos suspensivos en vez del valor -- para no
  // confundir "sensor sin dato" con "sensor midiendo 0".
  tft.setTextColor(COLOR_TEXTO);
  bool okPh   = datos.estado_dispositivos & BIT_SENSOR_PH_OK;
  bool okCond = datos.estado_dispositivos & BIT_SENSOR_COND_OK;
  bool okTurb = datos.estado_dispositivos & BIT_SENSOR_TURBIDEZ_OK;
  bool okTemp = datos.estado_dispositivos & BIT_SENSOR_TEMP_OK;

  tft.setCursor(2, 30);  tft.print("pH:   ");
  if (okPh) tft.print(datos.ph, 2); else tft.print(puntosSuspensivosAnimados());

  tft.setCursor(2, 44);  tft.print("Cond: ");
  if (okCond) { tft.print(datos.conductividad_us, 0); tft.print(" uS/cm"); }
  else tft.print(puntosSuspensivosAnimados());

  tft.setCursor(2, 58);  tft.print("OD:   ");
  tft.print(puntosSuspensivosAnimados());   // sensor de OD no instalado todavia

  tft.setCursor(2, 72);  tft.print("Turb: ");
  if (okTurb) { tft.print(datos.turbidez_ntu, 1); tft.print(" NTU"); }
  else tft.print(puntosSuspensivosAnimados());

  tft.setCursor(2, 86);  tft.print("Temp: ");
  if (okTemp) { tft.print(datos.temperatura_c, 1); tft.print(" C"); }
  else tft.print(puntosSuspensivosAnimados());

  tft.setCursor(2, 100); tft.print("Prof: ");
  if (okPh || okCond || okTurb || okTemp || datos.profundidad_cm > 0)
    { tft.print(datos.profundidad_cm, 0); tft.print(" cm"); }
  else tft.print(puntosSuspensivosAnimados());

  if (datos.error_flags != 0) {
    tft.fillRect(0, 114, PANTALLA_ANCHO, 12, COLOR_ALERTA);
    tft.setCursor(2, 116);
    tft.setTextColor(COLOR_TEXTO);
    tft.print("ALERTA cod 0x");
    tft.print(datos.error_flags, HEX);
  }

  tft.setTextColor(COLOR_ACENTO);
  tft.setCursor(4, 150);
  tft.print("BACK=menu OK=plano");
}

void pantalla_mensaje(const char* linea1, const char* linea2) {
  tft.fillScreen(COLOR_FONDO);
  tft.setTextSize(1);
  tft.setTextColor(COLOR_TEXTO);
  tft.setCursor(4, 74);
  tft.print(linea1);
  tft.setCursor(4, 86);
  tft.print(linea2);
}

// ======================================================================
// BOTONES - implementacion  (fuente: botones.cpp)
// ======================================================================


static unsigned long ultimoEvento = 0;

void botones_iniciar() {
  pinMode(BTN_UP, INPUT_PULLUP);
  pinMode(BTN_DOWN, INPUT_PULLUP);
  pinMode(BTN_OK, INPUT_PULLUP);
  pinMode(BTN_BACK, INPUT_PULLUP);
}

Boton botones_leer() {
  if (millis() - ultimoEvento < DEBOUNCE_MS) return BOTON_NINGUNO;

  Boton resultado = BOTON_NINGUNO;
  if (digitalRead(BTN_UP)   == LOW) resultado = BOTON_ARRIBA;
  else if (digitalRead(BTN_DOWN) == LOW) resultado = BOTON_ABAJO;
  else if (digitalRead(BTN_OK)   == LOW) resultado = BOTON_OK;
  else if (digitalRead(BTN_BACK) == LOW) resultado = BOTON_ATRAS;

  if (resultado != BOTON_NINGUNO) {
    ultimoEvento = millis();
    // ---- DIAGNOSTICO TEMPORAL: quitar estas 2 lineas cuando ya funcione ----
    const char* nombres[] = {"NINGUNO", "ARRIBA", "ABAJO", "OK", "ATRAS"};
    Serial.printf("[BOTON] detectado=%s  (UP=%d DOWN=%d OK=%d BACK=%d)\n",
                  nombres[resultado], digitalRead(BTN_UP), digitalRead(BTN_DOWN),
                  digitalRead(BTN_OK), digitalRead(BTN_BACK));
  }
  return resultado;
}

// ======================================================================
// BUZZER - alertas, encendido, apagado
// ======================================================================
// Implementado por toggle manual del pin (sin usar la API de LEDC), para
// que funcione identico sin importar la version del core ESP32 instalada.
// Sirve tanto para buzzer pasivo (necesita la frecuencia para sonar) como
// para buzzer activo (con oscilador propio: alcanza con ponerlo en HIGH).

void buzzer_iniciar() {
  pinMode(PIN_BUZZER, OUTPUT);
  digitalWrite(PIN_BUZZER, LOW);
}

// Genera un tono de 'frecuencia_hz' durante 'duracion_ms'.
// Buzzer PASIVO: se usa tal cual, la frecuencia define el tono.
// Buzzer ACTIVO: la frecuencia no importa (el buzzer ya oscila solo);
//   si el sonido se escucha entrecortado, cambiar el cuerpo de esta
//   funcion por: digitalWrite(PIN_BUZZER, HIGH); delay(duracion_ms);
//   digitalWrite(PIN_BUZZER, LOW);
void buzzer_tono(uint16_t frecuencia_hz, uint16_t duracion_ms) {
  if (frecuencia_hz == 0) { delay(duracion_ms); return; }
  uint32_t periodo_us = 1000000UL / frecuencia_hz;
  uint32_t medio_us   = periodo_us / 2;
  uint32_t ciclos     = ((uint32_t)duracion_ms * 1000UL) / periodo_us;
  for (uint32_t i = 0; i < ciclos; i++) {
    digitalWrite(PIN_BUZZER, HIGH);
    delayMicroseconds(medio_us);
    digitalWrite(PIN_BUZZER, LOW);
    delayMicroseconds(medio_us);
    yield();   // mismo motivo que en ascensor_homing() del Nodo Boya: un
               // bucle bloqueante largo sin ceder el CPU puede disparar
               // el Task Watchdog del ESP32 y reiniciar la placa a mitad
               // de una melodia -- eso reiniciaria estadoActual de vuelta
               // a UI_VINCULANDO, dando la apariencia de que "nunca avanza"
  }
}

// Dos notas ascendentes cortas -> se usa una vez en setup(), al energizar.
void buzzer_melodia_encendido() {
  buzzer_tono(1000, 90);
  delay(30);
  buzzer_tono(1600, 130);
}

// Dos notas descendentes -> lista para usarla cuando se agregue una rutina
// de apagado/reposo (hoy el firmware no tiene ese punto de entrada; queda
// disponible para llamarla apenas se defina ese flujo).
void buzzer_melodia_apagado() {
  buzzer_tono(1600, 100);
  delay(30);
  buzzer_tono(800, 160);
}

// Tres bips cortos e iguales -> alerta (error_flags != 0 en la telemetria).
void buzzer_melodia_alerta() {
  for (uint8_t i = 0; i < 3; i++) {
    buzzer_tono(2200, 90);
    delay(70);
  }
}

// Bip muy corto de confirmacion al presionar un boton valido.
void buzzer_clic() {
  if (!BUZZER_CLIC_BOTONES) return;
  buzzer_tono(1800, 25);
}

// ---- Melodias estilo "Mario Bros" (motivos cortos, no la cancion completa) ----

// Arpegio ascendente tipo "saliendo del tunel" -- se usa cuando la Boya
// (Nodo 2) se vincula por primera vez y llega el primer dato real.
void buzzer_melodia_vinculado() {
  buzzer_tono(523, 100);   // C5
  buzzer_tono(659, 100);   // E5
  buzzer_tono(784, 100);   // G5
  buzzer_tono(1047, 220);  // C6
}

// "Moneda" -- dos notas cortas, disponible para marcar eventos puntuales
// (por ejemplo, cada vez que se completa un ciclo de muestreo).
void buzzer_melodia_moneda() {
  buzzer_tono(988, 60);    // B5
  buzzer_tono(1319, 200);  // E6
}

// Descenso tipo "game over" -- se usa cuando se PIERDE el enlace con la
// Boya (pasa de conectado a no-conectado).
void buzzer_melodia_sin_conexion() {
  buzzer_tono(400, 150);
  delay(40);
  buzzer_tono(300, 150);
  delay(40);
  buzzer_tono(200, 280);
}

// Dos golpes graves cortos -- fallo puntual (ej. no se pudo enviar un
// comando de protocolo a la Boya).
void buzzer_melodia_falla() {
  buzzer_tono(150, 90);
  delay(60);
  buzzer_tono(150, 90);
}

// ======================================================================
// COMUNICACION ESP-NOW CON LA BOYA  (fuente: comunicacion_boya.cpp)
// ======================================================================


static DatosBoya_t datoInternoBoya;
static volatile bool datoNuevo = false;
static unsigned long ultimoDatoMillis = 0;
static volatile int ultimoLenCrudo = -1;      // *** DIAGNOSTICO: tamano de CUALQUIER
static volatile bool huboRecepcionCruda = false;  // paquete recibido, coincida o no el tamano esperado

static void procesarDatoRecibido(const uint8_t* data, int len) {
  ultimoLenCrudo = len;
  huboRecepcionCruda = true;
  if (len == sizeof(DatosBoya_t)) {
    memcpy((void*)&datoInternoBoya, data, sizeof(DatosBoya_t));
    datoNuevo = true;
    ultimoDatoMillis = millis();
  }
}

// --- callback de recepcion (se ejecuta en interrupcion, mantener corto) ---
#if ESP_IDF_VERSION_MAJOR >= 5
// Core ESP32 3.x (Arduino IDE reciente)
void IRAM_ATTR onDatoRecibido(const esp_now_recv_info_t* info, const uint8_t* data, int len) {
  procesarDatoRecibido(data, len);
}
#else
// Core ESP32 2.x
void IRAM_ATTR onDatoRecibido(const uint8_t* mac, const uint8_t* data, int len) {
  procesarDatoRecibido(data, len);
}
#endif

void espnow_iniciar() {
  WiFi.mode(WIFI_STA);
  delay(100);   // margen para que el radio Wi-Fi termine de levantar antes de leer la MAC
  Serial.print("MAC de este Tierra: ");
  Serial.println(WiFi.macAddress());

  if (esp_now_init() != ESP_OK) {
    Serial.println("ERROR: no se pudo iniciar ESP-NOW");
    return;
  }
  esp_now_register_recv_cb(onDatoRecibido);

  esp_now_peer_info_t peer = {};
  memcpy(peer.peer_addr, MAC_NODO_BOYA, 6);
  peer.channel = 0;      // 0 = usar el canal WiFi actual
  peer.encrypt = false;
  if (!esp_now_is_peer_exist(MAC_NODO_BOYA)) {
    esp_err_t r = esp_now_add_peer(&peer);
    Serial.print("esp_now_add_peer (Boya) resultado: ");
    Serial.println(r == ESP_OK ? "OK" : "ERROR");
  }
  Serial.println("ESP-NOW OK. Esperando paquetes de la Boya...");
}

bool espnow_enviar_comando(const ComandoTierra_t& cmd) {
  esp_err_t r = esp_now_send(MAC_NODO_BOYA, (const uint8_t*)&cmd, sizeof(cmd));
  return r == ESP_OK;
}

bool espnow_hay_datos_nuevos() {
  if (datoNuevo) {
    datoNuevo = false;
    return true;
  }
  return false;
}

DatosBoya_t espnow_obtener_ultimo_dato() {
  return datoInternoBoya;
}

bool espnow_enlace_activo() {
  // RF-CN-02: si no llega nada en mas de 2 minutos, se asume enlace caido
  // (los datos siguen a salvo en la microSD local de la Boya).
  return (millis() - ultimoDatoMillis) < (2UL * 60UL * 1000UL);
}

// ======================================================================
// ALMACENAMIENTO EN MICROSD  (fuente: almacenamiento.cpp)
// ======================================================================


static bool sdLista = false;
static const char* ARCHIVO_LOG = "/TELEMETRIA.CSV";

bool almacenamiento_iniciar() {
  // El bus SPI (SCK=18, MOSI=23, MISO=19) es compartido con la TFT;
  // SD.begin() se encarga de inicializarlo si aun no lo estaba.
  sdLista = SD.begin(SD_CS);

  if (sdLista && !SD.exists(ARCHIVO_LOG)) {
    File f = SD.open(ARCHIVO_LOG, FILE_WRITE);
    if (f) {
      f.println("timestamp,lat,lon,profundidad_cm,ph,conductividad_us,od_mgL,turbidez_ntu,temp_c,bateria_pct,protocolo,muestras_ciclo,error_flags,paquetes_perdidos");
      f.close();
    }
  }
  return sdLista;
}

bool almacenamiento_ok() {
  return sdLista;
}

void almacenamiento_guardar(const DatosBoya_t& d) {
  if (!sdLista) return;

  File f = SD.open(ARCHIVO_LOG, FILE_APPEND);
  if (!f) {
    sdLista = false;   // se perdio la tarjeta en caliente; se reintentara en el proximo ciclo
    return;
  }
  f.print(d.timestamp);        f.print(',');
  f.print(d.latitud, 6);       f.print(',');
  f.print(d.longitud, 6);      f.print(',');
  f.print(d.profundidad_cm,1); f.print(',');
  f.print(d.ph, 2);            f.print(',');
  f.print(d.conductividad_us,1); f.print(',');
  f.print(d.oxigeno_disuelto,2); f.print(',');
  f.print(d.turbidez_ntu,1);   f.print(',');
  f.print(d.temperatura_c,1);  f.print(',');
  f.print(d.bateria_pct);      f.print(',');
  f.print(d.protocolo_activo); f.print(',');
  f.print(d.muestras_ciclo);   f.print(',');
  f.print(d.error_flags);      f.print(',');
  f.println(d.paquetes_perdidos);
  f.close();
}

// ======================================================================
// SUBIDA A GOOGLE DRIVE  (fuente: nube.cpp)
// ======================================================================


// *** DIAGNOSTICO: en false para probar si la SD es la causa de que las
// pantallas no se actualicen despues del arranque (los botones SI se
// detectan y el estado SI cambia internamente, pero el redibujado no
// llega a la TFT). Si con esto en false el menu ya responde bien a los
// botones, confirmamos que la SD (o su cableado) es la culpable. ***
#define SD_ACTIVA false

// -------- REDES WIFI (se prueban en este orden, la primera que conecte se usa) --------
// *** DIAGNOSTICO: en false mientras se confirma que el problema de
// vinculacion ESP-NOW era el cambio de canal al conectar a una red WiFi.
// Cuando el enlace con la Boya ya funcione de forma confiable, volver a
// poner esto en true para recuperar la subida a la nube. ***
#define WIFI_NUBE_ACTIVA false
static const char* WIFI_SSID_1     = "UNILIBRE";
static const char* WIFI_PASSWORD_1 = "";                  // red abierta, sin clave
static const char* WIFI_SSID_2     = "PANCHA";
static const char* WIFI_PASSWORD_2 = "1012352195";
static const char* WIFI_SSID_3     = "ING Jair Montilla";
static const char* WIFI_PASSWORD_3 = "teamosamuel";
// Pega aqui la URL que te da Google al publicar el Apps Script
// (termina en /exec). Ver AppsScript_GoogleDrive.gs y el README.
static const char* URL_APPS_SCRIPT = "https://script.google.com/macros/s/TU_ID_DE_DESPLIEGUE/exec";
// ------------------------------------------

WiFiMulti wifiMulti;
static bool wifiIntentado = false;

void nube_iniciar() {
#if WIFI_NUBE_ACTIVA
  wifiMulti.addAP(WIFI_SSID_1, WIFI_PASSWORD_1);
  wifiMulti.addAP(WIFI_SSID_2, WIFI_PASSWORD_2);
  wifiMulti.addAP(WIFI_SSID_3, WIFI_PASSWORD_3);
  wifiMulti.run();     // arranca el intento; no bloquea (retorna el estado actual)
#else
  Serial.println("WIFI_NUBE_ACTIVA=false -- no se intenta conectar a ninguna red "
                  "(para no cambiar de canal y romper el enlace ESP-NOW con la Boya)");
#endif
  wifiIntentado = true;
  // No bloqueamos con delay(): el estado se revisa en nube_conectada()
}

bool nube_conectada() {
#if !WIFI_NUBE_ACTIVA
  return false;
#endif
  return wifiMulti.run() == WL_CONNECTED;   // wifiMulti.run() reintenta solo si se cayo
}

bool nube_subir(const DatosBoya_t& d) {
#if !WIFI_NUBE_ACTIVA
  return false;
#endif
  if (!wifiIntentado) nube_iniciar();
  if (wifiMulti.run() != WL_CONNECTED) return false;   // no bloquear el resto del sistema

  WiFiClientSecure client;
  // Google Apps Script usa certificados que rotan; validar la cadena
  // completa desde un ESP32 es engorroso y fragil. Por eso, igual que
  // en la mayoria de proyectos IoT con Apps Script, se omite la
  // verificacion del certificado. Es un compromiso aceptado en estos
  // proyectos porque el dato viajando (calidad de agua) no es sensible
  // como para justificar la complejidad de validar el certificado.
  client.setInsecure();

  HTTPClient http;
  http.begin(client, URL_APPS_SCRIPT);
  http.addHeader("Content-Type", "application/json");
  // Los Apps Script responden con una redireccion 302 antes de llegar
  // al contenido real: hay que decirle a HTTPClient que la siga.
  http.setFollowRedirects(HTTPC_STRICT_FOLLOW_REDIRECTS);

  String json = "{";
  json += "\"timestamp\":" + String(d.timestamp) + ",";
  json += "\"lat\":" + String(d.latitud, 6) + ",";
  json += "\"lon\":" + String(d.longitud, 6) + ",";
  json += "\"profundidad_cm\":" + String(d.profundidad_cm, 1) + ",";
  json += "\"ph\":" + String(d.ph, 2) + ",";
  json += "\"conductividad_us\":" + String(d.conductividad_us, 1) + ",";
  json += "\"od_mgL\":" + String(d.oxigeno_disuelto, 2) + ",";
  json += "\"turbidez_ntu\":" + String(d.turbidez_ntu, 1) + ",";
  json += "\"temp_c\":" + String(d.temperatura_c, 1) + ",";
  json += "\"bateria_pct\":" + String(d.bateria_pct) + ",";
  json += "\"protocolo\":" + String(d.protocolo_activo) + ",";
  json += "\"error_flags\":" + String(d.error_flags);
  json += "}";

  int codigo = http.POST(json);
  Serial.print("Google Apps Script respondio codigo: ");
  Serial.println(codigo);
  http.end();

  // Apps Script normalmente responde 200 (o 302 ya resuelto por la libreria)
  return (codigo >= 200 && codigo < 300);
}

// ======================================================================
// MODO PRUEBA - datos simulados (no toca nada del bloque ESP-NOW)
// ======================================================================
// Genera una telemetria de ejemplo con valores que varian suavemente en
// el tiempo, solo para poder ver y navegar las pantallas sin depender de
// que la Boya este encendida o configurada.
DatosBoya_t generarDatoPrueba() {
  DatosBoya_t d = {};
  float t = millis() / 1000.0f;

  // Ruido aleatorio (no solo seno) para que se vea mas "vivo" en pantalla.
  float ruidoPh    = ((float)random(-15, 16)) / 100.0f;   // +-0.15
  float ruidoCond  = (float)random(-8, 9);                // +-8
  float ruidoOd    = ((float)random(-20, 21)) / 100.0f;   // +-0.20
  float ruidoTurb  = ((float)random(-30, 31)) / 100.0f;   // +-0.30
  float ruidoTemp  = ((float)random(-25, 26)) / 100.0f;   // +-0.25
  float ruidoCol   = (float)random(-3, 4);
  float ruidoCal   = ((float)random(-50, 51)) / 100.0f;

  d.timestamp          = millis() / 1000;
  d.latitud            = 0.0f;
  d.longitud           = 0.0f;
  d.profundidad_cm     = 60.0f + 10.0f * sin(t / 5.0f) + ruidoCol;
  d.ph                 = 7.2f  + 0.3f  * sin(t / 7.0f) + ruidoPh;
  d.conductividad_us   = 350.0f + 20.0f * sin(t / 9.0f) + ruidoCond;
  d.oxigeno_disuelto   = 6.5f  + 0.5f  * sin(t / 6.0f) + ruidoOd;
  d.turbidez_ntu       = max(0.0f, 4.0f + 1.0f * sin(t / 4.0f) + ruidoTurb);
  d.temperatura_c      = 24.0f + 1.5f * sin(t / 8.0f) + ruidoTemp;
  d.bateria_pct        = 85;
  d.protocolo_activo   = PROTOCOLO_P1_AUTOMATICO;
  d.muestras_ciclo     = 1;
  // Cada ~30 s simula una alerta durante 4 s, solo para poder probar el
  // buzzer y la barra roja de alerta sin necesidad de la Boya encendida.
  d.error_flags        = (((unsigned long)t) % 30 < 4) ? 0x01 : 0;
  d.paquetes_perdidos  = 0;
  d.columna_total_cm   = 95.0f + 5.0f * sin(t / 6.0f) + ruidoCol;
  d.calado_boya_cm     = 12.0f + 2.0f * sin(t / 5.0f) + ruidoCal;
  d.pos_carro_cm       = d.profundidad_cm;
  d.estado_dispositivos = BIT_ASCENSOR_OK | BIT_BOMBA_PURGA_OK | BIT_BOMBA_MUESTREO_OK |
                           BIT_SENSOR_PH_OK | BIT_SENSOR_COND_OK | BIT_SENSOR_TURBIDEZ_OK |
                           BIT_SENSOR_TEMP_OK | BIT_US1_OK | BIT_US2_OK | BIT_US3_OK;

  // GPS simulado: avanza con pasos aleatorios (mismo criterio que el
  // simulador del Nodo Boya), para ver el trazado del lecho moverse.
  static float avanceSimulado = 0.0f;
  static unsigned long ultimoPasoGps = 0;
  if (millis() - ultimoPasoGps > 500) {
    ultimoPasoGps = millis();
    avanceSimulado += ((float)random(-20, 51)) / 100.0f;
    if (avanceSimulado < 0) avanceSimulado = 0;
  }
  d.gps_avance_m = avanceSimulado;

  // Ciclo simulado de fases (~4 s cada una), para probar los simbolos de
  // actuador activo en el plano cartesiano sin la Boya real conectada.
  uint8_t faseSimulada = (uint8_t)(((unsigned long)(t / 4.0f)) % 8);
  d.estado_fsm = faseSimulada;

  return d;
}

// ======================================================================
// PROGRAMA PRINCIPAL (setup/loop, menu)  (fuente: NodoTierra.ino)
// ======================================================================



// ---------------- Estados de la interfaz ----------------
// Secuencia obligatoria antes de poder elegir protocolo: primero se
// vincula con el Nodo 2 (Boya), luego se revisan los estados de sus
// sensores/actuadores, luego se ve la profundidad del cuerpo de agua en
// barras en vivo, y solo despues se habilita el menu de protocolos.
enum EstadoUI { UI_VINCULANDO, UI_ESTADOS, UI_BARRAS, UI_MENU, UI_CONFIG_P2, UI_ESTADO, UI_PLANO };
static EstadoUI estadoActual = UI_VINCULANDO;

// ---------------- Seleccion de protocolo (menu) ----------------
static uint8_t seleccionMenu = 0;   // 0=P1, 1=P2, 2=P3

// ---------------- Configuracion editable de P2 ----------------
static uint8_t  campoConfig = 0;          // 0=num_puntos, 1-5=cada punto, 6=muestras
static uint8_t  p2_numPuntos = 1;
static uint16_t p2_profundidades[5] = {60, 60, 60, 60, 60};  // cm, 0.6h por defecto (IDEAM)
static uint8_t  p2_muestras = 1;

// ---------------- Ultimo dato conocido de la Boya ----------------
static DatosBoya_t ultimoDato = {};
static bool hayDatoValido = false;

// ---------------- Temporizador de subida a la nube ----------------
static unsigned long ultimaSubidaNube = 0;
static const unsigned long INTERVALO_NUBE_MS = 60UL * 60UL * 1000UL; // 1 hora

void setup() {
  Serial.begin(115200);
  delay(200);
  randomSeed(analogRead(34) + millis());   // semilla real para el Modo Prueba
  Serial.println("========================================");
  Serial.println("NODO 1 -- TIERRA -- version v16 (2026-08-30)");
  Serial.println("con: plano cartesiano (lecho del rio), simbolos de");
  Serial.println("     actuador activo, Modo Prueba mas aleatorio");
  Serial.println("========================================");

  botones_iniciar();
  buzzer_iniciar();

  // Mantener OK presionado durante el encendido/reinicio para entrar
  // en Modo Prueba (telemetria simulada, sin depender de la Boya).
  delay(50);
  if (digitalRead(BTN_OK) == LOW) {
    g_modoPrueba = true;
    Serial.println("MODO PRUEBA activado (OK mantenido al encender)");
  }

  buzzer_melodia_encendido();
  pantalla_iniciar();
  pantalla_splash();

  // *** CAMBIO: el menu se muestra YA, antes de tocar SD/ESP-NOW/WiFi ***
  // Ya confirmamos (con las pruebas de relleno de color) que TODO lo
  // dibujado aqui, antes de almacenamiento_iniciar()/espnow_iniciar(),
  // SI llega correctamente a la pantalla fisica. El problema real esta
  // en los redibujados posteriores desde loop(). Mientras se investiga
  // la causa de fondo (posible interferencia de la SD o del radio
  // ESP-NOW en el bus SPI compartido), esto desbloquea el uso del menu
  // de inmediato: ya no se necesita esperar a que la Boya conecte.
  estadoActual = UI_MENU;
  pantalla_menu_protocolo(seleccionMenu);
  Serial.println("Menu de protocolos mostrado (ya no se espera a la Boya para verlo)");

  Serial.println("Iniciando microSD...");
#if SD_ACTIVA
  bool sdOk = almacenamiento_iniciar();
  if (!sdOk) Serial.println("AVISO: no se detecto microSD (revisar CS=GPIO4 y bus SPI, y que la tarjeta este formateada en FAT32)");
  else Serial.println("microSD OK");
#else
  bool sdOk = false;
  Serial.println("SD_ACTIVA=false -- se omite por completo (ni SD.begin() se llama), para "
                  "probar si la SD es la causa de que las pantallas no se actualicen");
#endif

  Serial.println("Iniciando ESP-NOW...");
  espnow_iniciar();
  Serial.println("ESP-NOW OK");

  Serial.println("Iniciando WiFi/nube...");
  nube_iniciar();   // no bloqueante; se reintenta sola en segundo plano
  Serial.println("Setup completo.");
}

void loop() {
  static uint16_t g_ultimoErrorFlags = 0;

  // ---------- 0) DIAGNOSTICO: cualquier paquete crudo recibido ----------
  // Se imprime pase o no el chequeo de tamano, para saber si el problema
  // es que no llega NADA, o que llega algo con el tamano equivocado.
  if (huboRecepcionCruda) {
    huboRecepcionCruda = false;
    Serial.printf("[ESP-NOW RX] llego un paquete de %d bytes (se esperan %d)\n",
                  ultimoLenCrudo, (int)sizeof(DatosBoya_t));
  }

  // ---------- 1) Procesar telemetria entrante de la Boya ----------
  bool llegoDatoNuevo = false;
  if (espnow_hay_datos_nuevos()) {
    ultimoDato = espnow_obtener_ultimo_dato();
    llegoDatoNuevo = true;
  }

  // ---------- 1b) Modo prueba: telemetria simulada (rama independiente) ----------
  static unsigned long ultimaSimulacion = 0;
  if (g_modoPrueba && millis() - ultimaSimulacion > 2000) {
    ultimoDato = generarDatoPrueba();
    ultimaSimulacion = millis();
    llegoDatoNuevo = true;
  }

  if (llegoDatoNuevo) {
    bool esPrimerDato = !hayDatoValido;
    hayDatoValido = true;
    almacenamiento_guardar(ultimoDato);
    if (ultimoDato.error_flags != 0 && g_ultimoErrorFlags == 0) {
      buzzer_melodia_alerta();
    }
    g_ultimoErrorFlags = ultimoDato.error_flags;

    // Primer paquete recibido (real o simulado) -> el Nodo 2 ya esta
    // vinculado. Antes esto dependia de estar en la pantalla UI_VINCULANDO,
    // pero desde que el menu aparece de inmediato al encender, esa pantalla
    // casi nunca se visita -- por eso el buzzer nunca sonaba. Ahora suena
    // sin importar en que pantalla este el usuario.
    if (esPrimerDato) {
      Serial.println("[UI] Primer dato real recibido de la Boya -- enlace confirmado");
      buzzer_melodia_vinculado();
      if (estadoActual == UI_VINCULANDO) {
        estadoActual = UI_ESTADOS;
      }
    }

    if (estadoActual == UI_ESTADO) {
      pantalla_estado(ultimoDato, espnow_enlace_activo() || g_modoPrueba, almacenamiento_ok());
    } else if (estadoActual == UI_ESTADOS) {
      pantalla_estados_dispositivos(ultimoDato);
    } else if (estadoActual == UI_BARRAS) {
      pantalla_barras(ultimoDato);
    } else if (estadoActual == UI_PLANO) {
      pantalla_plano_cartesiano(ultimoDato);
    }
  }

  // ---------- 1c) Animacion de puntos suspensivos mientras falten datos ----------
  // Deteccion de perdida de enlace (transicion conectado -> no conectado):
  // solo aplica una vez que ya hubo vinculacion real (no en el arranque).
  static bool g_enlaceEstabaActivo = false;
  if (hayDatoValido) {
    bool enlaceAhora = espnow_enlace_activo() || g_modoPrueba;
    if (g_enlaceEstabaActivo && !enlaceAhora) {
      buzzer_melodia_sin_conexion();
    }
    g_enlaceEstabaActivo = enlaceAhora;
  }
  // Redibuja periodicamente SOLO si hay algo que animar, para no gastar
  // tiempo de CPU redibujando pantallas que ya estan completas y quietas.
  static unsigned long ultimoTickAnimacion = 0;
  if (millis() - ultimoTickAnimacion > 300) {
    ultimoTickAnimacion = millis();
    if (estadoActual == UI_VINCULANDO) {
      pantalla_vinculando();
    } else if (estadoActual == UI_ESTADO && hayDatoValido) {
      uint16_t sensoresEsperados = BIT_SENSOR_PH_OK | BIT_SENSOR_COND_OK |
                                    BIT_SENSOR_TURBIDEZ_OK | BIT_SENSOR_TEMP_OK;
      bool faltaAlguno = (ultimoDato.estado_dispositivos & sensoresEsperados) != sensoresEsperados;
      if (faltaAlguno) {
        pantalla_estado(ultimoDato, espnow_enlace_activo() || g_modoPrueba, almacenamiento_ok());
      }
    }
  }

  // ---------- 2) Subida periodica a la nube (no bloqueante) ----------
  if (hayDatoValido && millis() - ultimaSubidaNube > INTERVALO_NUBE_MS) {
    if (nube_subir(ultimoDato)) {
      Serial.println("Subida a la nube OK");
    } else {
      Serial.println("Subida a la nube fallo (se reintenta en el proximo ciclo)");
    }
    ultimaSubidaNube = millis();
  }

  // ---------- 3) Leer botones y actualizar la maquina de estados ----------
  Boton b = botones_leer();
  if (b == BOTON_NINGUNO) return;
  buzzer_clic();

  switch (estadoActual) {

    case UI_VINCULANDO:
      // BACK = atajo manual para banco de pruebas sin la Boya encendida
      if (b == BOTON_ATRAS) {
        estadoActual = UI_MENU;
        pantalla_menu_protocolo(seleccionMenu);
      }
      break;

    case UI_ESTADOS:
      if (b == BOTON_OK || b == BOTON_ATRAS) {
        estadoActual = UI_BARRAS;
        pantalla_barras(hayDatoValido ? ultimoDato : DatosBoya_t{});
      }
      break;

    case UI_BARRAS:
      // Solo se puede pasar al menu de protocolos si ya se tiene una
      // lectura de la profundidad del cuerpo de agua (columna_total_cm).
      if (b == BOTON_OK) {
        if (hayDatoValido && ultimoDato.columna_total_cm > 0.0f) {
          estadoActual = UI_MENU;
          pantalla_menu_protocolo(seleccionMenu);
        } else {
          pantalla_mensaje("Esperando medicion", "de profundidad...");
          delay(1000);
          pantalla_barras(hayDatoValido ? ultimoDato : DatosBoya_t{});
        }
      }
      if (b == BOTON_ATRAS) {
        estadoActual = UI_ESTADOS;
        pantalla_estados_dispositivos(hayDatoValido ? ultimoDato : DatosBoya_t{});
      }
      break;

    case UI_MENU:
      if (b == BOTON_ARRIBA) seleccionMenu = (seleccionMenu == 0) ? 2 : seleccionMenu - 1;
      if (b == BOTON_ABAJO)  seleccionMenu = (seleccionMenu == 2) ? 0 : seleccionMenu + 1;
      // ---- DIAGNOSTICO TEMPORAL: quitar cuando ya funcione ----
      Serial.printf("[MENU] seleccionMenu=%d (0=P1,1=P2,2=P3)\n", seleccionMenu);
      if (b == BOTON_OK) {
        if (seleccionMenu == 1) {           // P2 -> ir a configuracion
          campoConfig = 0;
          estadoActual = UI_CONFIG_P2;
          pantalla_config_p2(campoConfig, p2_numPuntos, p2_profundidades, p2_muestras);
          return;
        } else {                            // P1 o P3 -> enviar directo, sin configuracion
          ComandoTierra_t cmd = {};
          cmd.comando = 1;
          cmd.protocolo_nuevo = (seleccionMenu == 0) ? PROTOCOLO_P1_AUTOMATICO : PROTOCOLO_P3_REACTIVO;
          bool enviado = espnow_enviar_comando(cmd);
          pantalla_mensaje(enviado ? "Protocolo enviado" : "Error al enviar",
                            enviado ? "a la Boya" : "revisar enlace ESP-NOW");
          delay(1200);
          estadoActual = UI_ESTADO;
          pantalla_estado(ultimoDato, espnow_enlace_activo(), almacenamiento_ok());
          return;
        }
      }
      if (b == BOTON_ATRAS) {               // atajo: ver ultimo estado conocido
        estadoActual = UI_ESTADO;
        pantalla_estado(ultimoDato, espnow_enlace_activo(), almacenamiento_ok());
        return;
      }
      pantalla_menu_protocolo(seleccionMenu);
      break;

    case UI_CONFIG_P2:
      if (b == BOTON_ATRAS) {               // cancelar, no se envia nada
        estadoActual = UI_MENU;
        pantalla_menu_protocolo(seleccionMenu);
        return;
      }
      if (b == BOTON_ARRIBA || b == BOTON_ABAJO) {
        int delta = (b == BOTON_ARRIBA) ? 1 : -1;
        if (campoConfig == 0) {
          p2_numPuntos = constrain((int)p2_numPuntos + delta, 1, 5);
        } else if (campoConfig >= 1 && campoConfig <= 5) {
          uint8_t idx = campoConfig - 1;
          // Rango 0-120 cm en pasos de 5, alineado al recorrido fisico del Ascensor
          int nuevo = (int)p2_profundidades[idx] + delta * 5;
          p2_profundidades[idx] = constrain(nuevo, 0, 120);
        } else if (campoConfig == 6) {
          p2_muestras = constrain((int)p2_muestras + delta, 1, 5);
        }
      }
      if (b == BOTON_OK) {
        if (campoConfig < p2_numPuntos) {
          campoConfig++;                    // pasar al siguiente punto de profundidad
        } else if (campoConfig < 6) {
          campoConfig = 6;                  // saltar directo a "muestras por ciclo"
        } else {
          // ultimo campo confirmado -> armar y enviar el comando completo
          ComandoTierra_t cmd = {};
          cmd.comando = 1;
          cmd.protocolo_nuevo = PROTOCOLO_P2_CONFIGURABLE;
          cmd.num_puntos_prof = p2_numPuntos;
          for (uint8_t i = 0; i < p2_numPuntos; i++) cmd.profundidades_cm[i] = p2_profundidades[i];
          cmd.muestras_por_ciclo = p2_muestras;

          bool enviado = espnow_enviar_comando(cmd);
          pantalla_mensaje(enviado ? "Config. P2 enviada" : "Error al enviar",
                            enviado ? "a la Boya" : "revisar enlace ESP-NOW");
          delay(1200);
          estadoActual = UI_ESTADO;
          pantalla_estado(ultimoDato, espnow_enlace_activo(), almacenamiento_ok());
          return;
        }
      }
      pantalla_config_p2(campoConfig, p2_numPuntos, p2_profundidades, p2_muestras);
      break;

    case UI_ESTADO:
      if (b == BOTON_ATRAS) {
        estadoActual = UI_MENU;
        pantalla_menu_protocolo(seleccionMenu);
        return;
      }
      if (b == BOTON_OK) {
        estadoActual = UI_PLANO;
        pantalla_plano_cartesiano(hayDatoValido ? ultimoDato : DatosBoya_t{});
        return;
      }
      // UP/DOWN en esta pantalla no hacen nada por ahora (reservado a futuro,
      // por ejemplo para desplazarse entre varias lecturas historicas)
      break;

    case UI_PLANO:
      if (b == BOTON_ATRAS) {
        estadoActual = UI_MENU;
        pantalla_menu_protocolo(seleccionMenu);
        return;
      }
      if (b == BOTON_OK) {
        estadoActual = UI_ESTADO;
        pantalla_estado(ultimoDato, espnow_enlace_activo() || g_modoPrueba, almacenamiento_ok());
        return;
      }
      break;
  }
}

